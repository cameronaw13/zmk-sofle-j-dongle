/*
 * ESB split addresses - shared by the dongle (central) and both halves.
 */

/ {
		esb_split {
			compatible = "zmk,esb-split";
			base-addr-0 = <0x27 0x1B 0x94 0x63>;
			base-addr-1 = <0x8D 0x5A 0xE2 0x41>;
			addr-prefix = <0xE7 0xC2 0xC3 0xC4 0xC5 0xC6 0xC7 0xC8>;
		};
};
