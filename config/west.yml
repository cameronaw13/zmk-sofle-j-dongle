## config/west.yml
```yaml
manifest:
  remotes:
    - name: badjeff
      url-base: https://github.com/badjeff
    - name: cameronaw13
      url-base: https://github.com/cameronaw13
    - name: nrfconnect
      url-base: https://github.com/nrfconnect
    - name: zmkfirmware
      url-base: https://github.com/zmkfirmware
    - name: englmaxi
      url-base: https://github.com/englmaxi
  projects:
    #  ZMK 0.4 / Zephyr 4.1 line, via badjeff's fork
    - name: zmk
      remote: zmkfirmware
      revision: main
      import: app/west.yml
    # Enhanced ShockBurst split transport
    - name: zmk-feature-split-esb
      remote: cameronaw13
      revision: main
    # Nordic NCS 3.1 + nrfxlib for ESB driver + MPSL radio layer
    - name: sdk-nrf
      remote: badjeff
      revision: v3.1-branch+zmk-fixes
      path: nrf
    - name: nrfxlib
      remote: nrfconnect
      revision: v3.1-branch
      repo-path: sdk-nrfxlib
      path: nrfxlib
    # Dongle OLED module
    - name: zmk-dongle-display
      remote: englmaxi
      revision: main
  self:
    path: config
```
